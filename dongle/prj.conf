## prj.conf
```kconfig
#
# Copyright (c) 2019 Nordic Semiconductor ASA
#
# SPDX-License-Identifier: LicenseRef-Nordic-5-Clause
#
# CONFIG_NCS_SAMPLES_DEFAULTS=y
CONFIG_MAIN_STACK_SIZE=2048
CONFIG_ESB=y
# CONFIG_ESB_MAX_PAYLOAD_LENGTH=110
CONFIG_ESB_MAX_PAYLOAD_LENGTH=77

#USB related configs
CONFIG_USB_DEVICE_STACK=y
CONFIG_USB_DEVICE_PRODUCT="Smart Remote dongle"

#LOG subsystem related configs
CONFIG_LOG=y
CONFIG_USB_DRIVER_LOG_LEVEL_ERR=y
CONFIG_USB_DEVICE_LOG_LEVEL_ERR=y
# CONFIG_USB_AUDIO_LOG_LEVEL_DBG=y


#net buf options
CONFIG_NET_BUF=y

#USB audio related configs
CONFIG_USB_DEVICE_AUDIO=y

#FLASH
CONFIG_FLASH=y
CONFIG_FLASH_PAGE_LAYOUT=y
CONFIG_MPU_ALLOW_FLASH_WRITE=y
CONFIG_SOC_FLASH_NRF_EMULATE_ONE_BYTE_WRITE_ACCESS=y
```

## nrf52840dk_nrf52840.overlay
```dts
// To get started, press Ctrl+Space to bring up the completion menu and view the available nodes.

// You can also use the buttons in the sidebar to perform actions on nodes.
// Actions currently available include:

// * Enabling / disabling the node
// * Adding the bus to a bus
// * Removing the node
// * Connecting ADC channels

// For more help, browse the DeviceTree documentation at https://docs.zephyrproject.org/latest/guides/dts/index.html
// You can also visit the nRF DeviceTree extension documentation at https://nrfconnect.github.io/vscode-nrf-connect/devicetree/nrfdevicetree.html
&zephyr_udc0 {
	// hp_0 {
	// 	compatible = "usb-audio-hp";
	// 	feature-mute;
	// 	channel-l;
	// 	channel-r;
	// };
	mic_0 {
		compatible = "usb-audio-mic";
		feature-mute;
		channel-l;
		// channel-r;
	};
};
```

## src/main.c
```c
/*
 * Copyright (c) 2018 Nordic Semiconductor ASA
 *
 * SPDX-License-Identifier: LicenseRef-Nordic-5-Clause
 */
#include <zephyr/device.h>
#include <zephyr/devicetree.h>
#include <zephyr/drivers/clock_control.h>
#include <zephyr/drivers/clock_control/nrf_clock_control.h>
#include <zephyr/drivers/gpio.h>
#include <zephyr/irq.h>
#include <zephyr/logging/log.h>
#include <nrf.h>
#include <esb.h>
#include <zephyr/kernel.h>
#include <zephyr/types.h>
#include "esb_handle.h"
#include "dvi_adpcm.h"
#include "usb_audio_app.h"
#include <zephyr/usb/usb_device.h>
#include <zephyr/usb/class/usb_audio.h>


LOG_MODULE_REGISTER(smart_dongle, CONFIG_ESB_PRX_APP_LOG_LEVEL);

#define FW_VERSION				"1.2.1"

dvi_adpcm_state_t    m_adpcm_state;

static const struct gpio_dt_spec leds[] = {
	GPIO_DT_SPEC_GET(DT_ALIAS(led0), gpios),
	GPIO_DT_SPEC_GET(DT_ALIAS(led1), gpios),
	GPIO_DT_SPEC_GET(DT_ALIAS(led2), gpios),
	GPIO_DT_SPEC_GET(DT_ALIAS(led3), gpios),
};

BUILD_ASSERT(DT_SAME_NODE(DT_GPIO_CTLR(DT_ALIAS(led0), gpios),
			  DT_GPIO_CTLR(DT_ALIAS(led1), gpios)) &&
	     DT_SAME_NODE(DT_GPIO_CTLR(DT_ALIAS(led0), gpios),
			  DT_GPIO_CTLR(DT_ALIAS(led2), gpios)) &&
	     DT_SAME_NODE(DT_GPIO_CTLR(DT_ALIAS(led0), gpios),
			  DT_GPIO_CTLR(DT_ALIAS(led3), gpios)),
	     "All LEDs must be on the same port");


static struct esb_payload tx_payload = ESB_CREATE_PAYLOAD(0,
	0x10, 0x11, 0x12, 0x13, 0x14, 0x15, 0x16, 0x17);


static int leds_init(void)
{
	if (!device_is_ready(leds[0].port)) {
		LOG_ERR("LEDs port not ready");
		return -ENODEV;
	}

	for (size_t i = 0; i < ARRAY_SIZE(leds); i++) {
		int err = gpio_pin_configure_dt(&leds[i], GPIO_OUTPUT);

		if (err) {
			LOG_ERR("Unable to configure LED%u, err %d.", i, err);
			return err;
		}

		gpio_pin_set(leds[0].port, leds[i].pin, 0);
	}

	return 0;
}


int leds_toggle(void)
{
	// for (size_t i = 0; i < ARRAY_SIZE(leds); i++) 
	{
		gpio_pin_toggle(leds[0].port, leds[0].pin);
	}

	return 0;
}





int clocks_start(void)
{
	int err;
	int res;
	struct onoff_manager *clk_mgr;
	struct onoff_client clk_cli;

	clk_mgr = z_nrf_clock_control_get_onoff(CLOCK_CONTROL_NRF_SUBSYS_HF);
	if (!clk_mgr) {
		LOG_ERR("Unable to get the Clock manager");
		return -ENXIO;
	}

	sys_notify_init_spinwait(&clk_cli.notify);

	err = onoff_request(clk_mgr, &clk_cli);
	if (err < 0) {
		LOG_ERR("Clock request failed: %d", err);
		return err;
	}

	do {
		err = sys_notify_fetch_result(&clk_cli.notify, &res);
		if (!err && res) {
			LOG_ERR("Clock could not be started: %d", res);
			return res;
		}
	} while (err);

	LOG_DBG("HF clock started, fw_version is %s", FW_VERSION);
	return 0;
}


int main(void)
{
	int err;

	LOG_INF("Enhanced ShockBurst prx sample");

	err = clocks_start();
	if (err) {
		return err;
	}

	err = leds_init();
	if (err) {
		return err;
	}

	dvi_adpcm_init_state(&m_adpcm_state);

	// usb_audio_init();

	err = esb_initialize();
	if (err) {
		LOG_ERR("ESB initialization failed, err %d", err);
		return err;
	}

	LOG_INF("Initialization complete");

	err = esb_write_payload(&tx_payload);
	if (err) {
		LOG_ERR("Write payload, err %d", err);
		return err;
	}

	LOG_INF("Setting up for packet receiption");

	err = esb_start_rx();
	if (err) {
		LOG_ERR("RX setup failed, err %d", err);
		return err;
	}

	/* return to idle thread */
	return 0;
}
```

## src/drv_flash.c
```c
#include <zephyr/kernel.h>
#include <zephyr/drivers/flash.h>
#include <zephyr/logging/log.h>
#include <zephyr/storage/flash_map.h>
#include <zephyr/device.h>
#include <zephyr/devicetree.h>
#include <stdio.h>

#include "drv_flash.h"

LOG_MODULE_REGISTER(soc_flash, CONFIG_ESB_PRX_APP_LOG_LEVEL);



const struct device *flash_dev = TEST_PARTITION_DEVICE;


void soc_flash_init(void)
{
    if (!device_is_ready(flash_dev)) {
		LOG_DBG("Flash device not ready\n");
		return ;
	}

	LOG_DBG("\nTest 1: Flash erase page at 0x%x\n", TEST_PARTITION_OFFSET);
	LOG_DBG("\nTest 1: Flash partition size = %d\n", TEST_PARTITION_SIZE);

	if (flash_erase(flash_dev, TEST_PARTITION_OFFSET, TEST_PARTITION_SIZE) != 0) {
		LOG_ERR("   Flash erase failed!\n");
	} 
    else 
    {
		LOG_DBG("   Flash erase succeeded!\n");
	}
}



int soc_flash_write(off_t offset, const void * data, size_t len)
{
    if (flash_write(flash_dev, offset, data, len) != 0) 
    {
        LOG_ERR("   Flash write failed!\n");
        return -1;
    }

    return 0;
}
	
```

## src/drv_flash.h
```c
#ifndef __DRV_FLASH_H__
#define __DRV_FLASH_H__

// #include <zephyr/kernel.h>
// #include <zephyr/drivers/flash.h>
#include <zephyr/storage/flash_map.h>

#define TEST_PARTITION	slot1_partition

#define TEST_PARTITION_OFFSET	FIXED_PARTITION_OFFSET(TEST_PARTITION)
#define TEST_PARTITION_SIZE		FIXED_PARTITION_SIZE(TEST_PARTITION)
#define TEST_PARTITION_DEVICE	FIXED_PARTITION_DEVICE(TEST_PARTITION)



void soc_flash_init(void);

int soc_flash_write(off_t offset, const void * data, size_t len);


#endif
```

## src/esb_handle.c
```c
#include <zephyr/kernel.h>
#include <zephyr/logging/log.h>
#include <esb.h>
#include "dvi_adpcm.h"
#include "esb_handle.h"


LOG_MODULE_DECLARE(smart_dongle, CONFIG_ESB_PRX_APP_LOG_LEVEL);


/* Driver will allocate blocks from this slab to save adpcm data into them.
 * Application, after getting a given block then push it to the esb send message queue,
 * needs to free that block.
 */

K_MEM_SLAB_DEFINE(esb_slab, ESB_BLOCK_SIZE, ESB_BLOCK_COUNT, 4);

K_MSGQ_DEFINE(esb_queue, 4, ESB_BLOCK_COUNT, 4);

K_SEM_DEFINE(esb_sem, 0, 1);

/** this pointer variable used for transport the message queue to USB audio thread.*/
void *block_ptr = NULL;

extern dvi_adpcm_state_t m_adpcm_state;


static void event_handler(struct esb_evt const *event)
{
	switch (event->evt_id) {
	case ESB_EVENT_TX_SUCCESS:
		// LOG_DBG("TX SUCCESS EVENT");
		break;
	case ESB_EVENT_TX_FAILED:
		LOG_DBG("TX FAILED EVENT");
		break;
	case ESB_EVENT_RX_RECEIVED:
        // esb_buffer_handle();
		/* notify thread that data is available */
    	k_sem_give(&esb_sem);

		// if (esb_read_rx_payload(&rx_payload) == 0) {
		// 	LOG_INF("Packet received, len %d : "
		// 		"0x%02x, 0x%02x, 0x%02x, 0x%02x ",				
		// 		rx_payload.length, rx_payload.data[0],
		// 		rx_payload.data[1], rx_payload.data[2],
		// 		rx_payload.data[3] );
		// 	gpio_pin_toggle(leds[0].port, leds[0].pin);			
		// } else {
		// 	LOG_ERR("Error while reading rx packet");
		// }
		break;
	}
}

int esb_initialize(void)
{
	int err;
	/* These are arbitrary default addresses. In end user products
	 * different addresses should be used for each set of devices.
	 */
	uint8_t base_addr_0[4] = {0xE7, 0xE5, 0xE7, 0xE5};
	uint8_t base_addr_1[4] = {0xC2, 0xC2, 0xC2, 0xC2};
	uint8_t addr_prefix[8] = {0xE7, 0xC2, 0xC3, 0xC4, 0xC5, 0xC6, 0xC7, 0xC8};

	struct esb_config config = ESB_DEFAULT_CONFIG;

	config.protocol = ESB_PROTOCOL_ESB_DPL;
	config.retransmit_delay = 250;//600;
	config.retransmit_count = 1;
	config.bitrate = ESB_BITRATE_2MBPS;
	config.mode = ESB_MODE_PRX;
	config.event_handler = event_handler;
	config.selective_auto_ack = true;

	err = esb_init(&config);
	if (err) {
		return err;
	}

	err = esb_set_base_address_0(base_addr_0);
	if (err) {
		return err;
	}

	err = esb_set_base_address_1(base_addr_1);
	if (err) {
		return err;
	}

	err = esb_set_prefixes(addr_prefix, ARRAY_SIZE(addr_prefix));
	if (err) {
		return err;
	}

	return 0;
}


static void mono_to_stereo(int16_t* src_audio, int frames, int16_t* dst_audio) 
{
    for (int i = 0; i < frames; i++) 
    {
        dst_audio[2 * i] = src_audio[i];
        dst_audio[2 * i + 1] = src_audio[i];
    }
}


void esb_buffer_handle(void)
{
    int err = 0;
    int frame_size = 0;
	uint8_t adpcm_index = 0;
    struct esb_payload rx_payload;

    if (esb_read_rx_payload(&rx_payload) == 0) 
    {
        LOG_INF("Packet received, len %d ", rx_payload.length);
        //     "0x%02x, 0x%02x, 0x%02x, 0x%02x ",				
        //     rx_payload.length, rx_payload.data[0],
        //     rx_payload.data[1], rx_payload.data[2],
        //     rx_payload.data[3] );
	#if 1
		while(adpcm_index + ADPCM_BLOCK_SIZE <= rx_payload.length)
		{
			if(k_mem_slab_alloc(&esb_slab, (void **) &block_ptr, K_MSEC(1)) == 0)
			{
				dvi_adpcm_decode(&(rx_payload.data[adpcm_index]), ADPCM_BLOCK_SIZE, block_ptr, &frame_size, &m_adpcm_state);
				// LOG_INF("adpcm_index=%d, ADPCMdecompress %u bytes", adpcm_index, frame_size);
				// LOG_HEXDUMP_INF(block_ptr, 8, "ADPCM decompress");
    
				/** send the PCM data to USB audio driver*/
				err = k_msgq_put(&esb_queue, &block_ptr, K_NO_WAIT);
				if (err) {
					LOG_ERR("Message sent error: %d", err);
				}

				adpcm_index += ADPCM_BLOCK_SIZE;
			}
			else 
			{
				LOG_ERR("Memory allocation for ESB receive time-out");
				break;
			}	
		}
	#endif
    } 
    else 
    {
        LOG_ERR("Error while reading esb rx packet");
    }
}


void free_esb_slab_memory(void *buffer)
{
	k_mem_slab_free(&esb_slab, buffer);
}
```

## src/esb_handle.h
```c
#ifndef __ESB_HANDLE_H__
#define __ESB_HANDLE_H__

#include <stdint.h>


#define MAX_SAMPLE_RATE             16000
#define SAMPLE_BIT_WIDTH            16
#define BYTES_PER_SAMPLE            sizeof(int16_t)

/* Size of a block for 10 ms of audio data. */
#define BLOCK_SIZE(_sample_rate, _number_of_ms) \
	(BYTES_PER_SAMPLE * (_sample_rate / 1000) * _number_of_ms)

#define MAX_BLOCK_SIZE              BLOCK_SIZE(MAX_SAMPLE_RATE, 1)

#define ADPCM_BLOCK_SIZE			(MAX_BLOCK_SIZE/4 + 3)

#define ESB_BLOCK_SIZE              MAX_BLOCK_SIZE
#define ESB_BLOCK_COUNT             500


int esb_initialize(void);

void esb_buffer_handle(void);

void free_esb_slab_memory(void *buffer);

#endif
```

## src/usb_audio.c
```c
#include <zephyr/kernel.h>
#include <zephyr/logging/log.h>
#include "usb_audio.h"
#include "esb_handle.h"

LOG_MODULE_DECLARE(smart_dongle, CONFIG_ESB_PRX_APP_LOG_LEVEL);


#define USB_AUDIO_STACK_SIZE        2048
#define USB_AUDIO_PRIORITY          3

// K_SEM_DEFINE(esb_sem, 0, 1);


extern struct k_msgq esb_queue;


static void esb_audio_data_handle(void *, void *, void *)
{
	int err = 0;

    LOG_INF("adpcm decoder thread start......");

    while(1)
    {
        int16_t *frame_buffer = NULL;

		k_msgq_get(&esb_queue, &frame_buffer, K_FOREVER);

        /** USB audio driver handle the pcm stream*/
        LOG_HEXDUMP_INF(frame_buffer, 8, "Receive audio queue");



        //free the memory slab
		free_esb_slab_memory(frame_buffer);	
    }
}





K_THREAD_DEFINE(esb_audio_service, USB_AUDIO_STACK_SIZE,
                esb_audio_data_handle, NULL, NULL, NULL,
                K_PRIO_PREEMPT(USB_AUDIO_PRIORITY), 0, 0);
```

## src/usb_audio.h
```c
#ifndef __USB_AUDIO_H__
#define __USB_AUDIO_H__

#include <stdint.h>


#endif
```

## src/usb_audio_app.c
```c
#include <zephyr/kernel.h>
#include <zephyr/logging/log.h>
#include <zephyr/usb/usb_device.h>
#include <zephyr/usb/class/usb_audio.h>
#include "usb_audio_app.h"
#include "esb_handle.h"
#include "drv_flash.h"

LOG_MODULE_DECLARE(smart_dongle, CONFIG_ESB_PRX_APP_LOG_LEVEL);


#define USB_AUDIO_STACK_SIZE        2048
#define USB_AUDIO_PRIORITY          3




NET_BUF_POOL_FIXED_DEFINE(pool_out, CONFIG_FIFO_FRAME_SPLIT_NUM, USB_FRAME_SIZE_STEREO, 8, net_buf_destroy);

static const struct device *const mic_dev = DEVICE_DT_GET_ONE(usb_audio_mic);

extern struct k_msgq esb_queue;

extern struct k_sem esb_sem;


extern int leds_toggle(void);




/*
* single channel transform to dual channels.
*
* @param[in] src_audio 	Pointer to the single channel source pcm stream.
*			 frames	   	Length of the stram buffer
*			 dst_audio	Pointer to the target dual channel pcm stream
*/
static void mono_to_stereo(int16_t* src_audio, int frames, int16_t* dst_audio) 
{
    for (int i = 0; i < frames; i++) 
    {
        dst_audio[2 * i] = src_audio[i];
        dst_audio[2 * i + 1] = src_audio[i];
    }
}


static void data_write(const struct device *dev)
{
	// LOG_INF("data were requested from the device and may be send to the Host!");
	static uint32_t timeCount = 0;
	if(0 == (timeCount++ % 50))
		leds_toggle();

    int ret = 0;
    void *frame_buffer = NULL;
    size_t data_out_size = 0;
     
    struct net_buf *buf_out;

	buf_out = net_buf_alloc(&pool_out, K_NO_WAIT);
	if (!buf_out) 
	{
		LOG_ERR("Failed to allocate data buffer");
		return;
	}

    if(k_msgq_get(&esb_queue, &frame_buffer, K_NO_WAIT) != 0)
    {
        // LOG_WRN("USB audio TX underrun");
		net_buf_unref(buf_out);
		return;
    }
   
    // LOG_HEXDUMP_INF(frame_buffer, 8, "Receive audio queue");
	mono_to_stereo((int16_t*) frame_buffer, MAX_BLOCK_SIZE/2, (int16_t*)buf_out->data);
	// memcpy(buf_out->data, frame_buffer, buf_out->size);
	data_out_size =  buf_out->size;
    /** free the memory slab */
    free_esb_slab_memory(frame_buffer);	

	 /** USB audio driver handle the pcm stream*/
	if (data_out_size == usb_audio_get_in_frame_size(dev)) 
    {
		ret = usb_audio_send(dev, buf_out, data_out_size);
		if (ret) {
			LOG_WRN("USB TX failed, ret: %d", ret);
			net_buf_unref(buf_out);
		}
		// else
		// {	
		// 	LOG_INF("usb audio send %d bytes succeed!\t", data_out_size);
		// }
	} 
    else 
    {
		LOG_WRN("Wrong size write: %d", data_out_size);
	}
}

static void feature_update(const struct device *dev,
			   const struct usb_audio_fu_evt *evt)
{
	LOG_DBG("Control selector %d for channel %d updated",
		evt->cs, evt->channel);
	switch (evt->cs) {
	case USB_AUDIO_FU_MUTE_CONTROL:
	default:
		break;
	}
}



static const struct usb_audio_ops mic_ops = {
	.data_request_cb = data_write,
	.feature_update_cb = feature_update,
};


void usb_audio_init(void)
{
	int ret;

	if (!device_is_ready(mic_dev)) {
		LOG_ERR("Device USB Microphone is not ready");
		return;
	}
	LOG_INF("Found USB Microphone Device");

	usb_audio_register(mic_dev, &mic_ops);

	ret = usb_enable(NULL);
	if (ret != 0) {
		LOG_ERR("Failed to enable USB");
		return;
	}

	LOG_INF("USB enabled");
	LOG_INF("mic_frame_size = %d\t ", usb_audio_get_in_frame_size(mic_dev));
}



static void esb_audio_data_handle(void *, void *, void *)
{
	int ret;
	// static uint32_t total_size = 0;

	// soc_flash_init();

	if (!device_is_ready(mic_dev)) {
		LOG_ERR("Device USB Microphone is not ready");
		return;
	}
	LOG_INF("Found USB Microphone Device");

	usb_audio_register(mic_dev, &mic_ops);

	ret = usb_enable(NULL);
	if (ret != 0) {
		LOG_ERR("Failed to enable USB");
		return;
	}

	LOG_INF("USB enabled");
	LOG_INF("mic_frame_size = %d\t ", usb_audio_get_in_frame_size(mic_dev));

    while(1)
    {
        k_sem_take(&esb_sem, K_FOREVER);
		esb_buffer_handle();
    }

}


K_THREAD_DEFINE(esb_audio_service, USB_AUDIO_STACK_SIZE,
                esb_audio_data_handle, NULL, NULL, NULL,
                K_PRIO_PREEMPT(USB_AUDIO_PRIORITY), 0, 0);
```

## src/usb_audio_app.h
```c
#ifndef __USB_AUDIO_APP_H__
#define __USB_AUDIO_APP_H__

#include <stdint.h>


#define CONFIG_AUDIO_SAMPLE_RATE_HZ         16000
#define CONFIG_AUDIO_BIT_DEPTH_OCTETS       2

#define USB_FRAME_SIZE_STEREO               (((CONFIG_AUDIO_SAMPLE_RATE_HZ * CONFIG_AUDIO_BIT_DEPTH_OCTETS) / 1000) *2)

#define CONFIG_FIFO_FRAME_SPLIT_NUM         10



// void usb_audio_init(void);


#endif
```
