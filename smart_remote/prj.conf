## CMakeLists.txt
```
#
# Copyright (c) 2019 Nordic Semiconductor
#
# SPDX-License-Identifier: LicenseRef-Nordic-5-Clause
#
cmake_minimum_required(VERSION 3.20.0)

find_package(Zephyr REQUIRED HINTS $ENV{ZEPHYR_BASE})
project(NONE)

if (CONFIG_SOC_NRF5340_CPUAPP)
  message(FATAL_ERROR "This sample is not supported on the nRF53 application core")
endif()

# NORDIC SDK APP START
target_sources(app PRIVATE
  src/main.c
  src/sound_service.c
  src/drivers/drv_mic.c
  src/events/mic_work_event.c
  ../common/app_bt_hid.c
  ../common/app_timeslot.c
  ../common/app_esb.c
  # ../common/circle_test/circle_test.c
  ../common/dvi_adpcm.c
)
# NORDIC SDK APP END
zephyr_library_include_directories(src/drivers/)
zephyr_library_include_directories(src/events/)
zephyr_library_include_directories(../common)
# zephyr_library_include_directories(../common/circle_test)
```

## prj.conf
```kconfig
#
# Copyright (c) 2019 Nordic Semiconductor
#
# SPDX-License-Identifier: LicenseRef-Nordic-5-Clause
#

CONFIG_NCS_SAMPLES_DEFAULTS=y
CONFIG_HEAP_MEM_POOL_SIZE=2048
CONFIG_MAIN_STACK_SIZE=2048

CONFIG_CONSOLE_SUBSYS=y
CONFIG_CONSOLE_HANDLER=y
CONFIG_CONSOLE_GETCHAR=y

CONFIG_MPSL=y
CONFIG_MPSL_TIMESLOT_SESSION_COUNT=2
CONFIG_RING_BUFFER=y
CONFIG_LOG=y
CONFIG_LOG_MODE_DEFERRED=y

CONFIG_BT=y
CONFIG_ESB_BT_LOG_LEVEL=3
# CONFIG_BT_DEBUG_LOG=y
CONFIG_BT_MAX_CONN=1
CONFIG_BT_MAX_PAIRED=1
CONFIG_BT_SMP=y
CONFIG_BT_L2CAP_TX_BUF_COUNT=5
CONFIG_BT_PERIPHERAL=y
CONFIG_BT_DEVICE_NAME="MPSL_ESB_BLE_Demo"
CONFIG_BT_DEVICE_APPEARANCE=962


CONFIG_BT_BAS=y
CONFIG_BT_HIDS=y
CONFIG_BT_HIDS_MAX_CLIENT_COUNT=1
CONFIG_BT_HIDS_DEFAULT_PERM_RW_ENCRYPT=y
CONFIG_BT_GATT_UUID16_POOL_SIZE=40
CONFIG_BT_GATT_CHRC_POOL_SIZE=20

CONFIG_BT_CONN_CTX=y

CONFIG_BT_DIS=y
CONFIG_BT_DIS_PNP=y
CONFIG_BT_DIS_MANUF="NordicSemiconductor"
CONFIG_BT_DIS_PNP_VID_SRC=2
CONFIG_BT_DIS_PNP_VID=0x1915
CONFIG_BT_DIS_PNP_PID=0xEEEE
CONFIG_BT_DIS_PNP_VER=0x0100

CONFIG_DK_LIBRARY=y

CONFIG_SYSTEM_WORKQUEUE_STACK_SIZE=2048

CONFIG_BT_SETTINGS=y
CONFIG_FLASH=y
CONFIG_FLASH_PAGE_LAYOUT=y
CONFIG_FLASH_MAP=y
CONFIG_NVS=y
CONFIG_SETTINGS=y

CONFIG_DYNAMIC_INTERRUPTS=y
CONFIG_DYNAMIC_DIRECT_INTERRUPTS=y

CONFIG_ESB=y
CONFIG_ESB_DYNAMIC_INTERRUPTS=y
CONFIG_ESB_MAX_PAYLOAD_LENGTH=110
# CONFIG_ESB_MAX_PAYLOAD_LENGTH=220

# 7.5ms BT connection interval
CONFIG_BT_PERIPHERAL_PREF_MIN_INT=6
CONFIG_BT_PERIPHERAL_PREF_MAX_INT=6

#Packet Timer
CONFIG_NRFX_TIMER3=y

#PDM
CONFIG_AUDIO=y
CONFIG_AUDIO_DMIC=y

# Application Event Manager
CONFIG_APP_EVENT_MANAGER=y
```

## src/main.c
```c
/*
 * Copyright (c) 2019 Nordic Semiconductor ASA
 *
 * SPDX-License-Identifier: LicenseRef-Nordic-5-Clause
 */

/*
MODIFIED SAMPLE TO INCLUDE EXTENSIONS ++
*/

#include <zephyr/kernel.h>
#include <zephyr/console/console.h>
#include <app_event_manager.h>
#include <string.h>
#include <zephyr/sys/printk.h>
#include <zephyr/types.h>
#include <zephyr/logging/log.h>
#include <zephyr/drivers/gpio.h> 
#include <esb.h>
#include "app_bt_hid.h"
#include "app_timeslot.h"
#include "app_esb.h"
#include "drv_mic.h"
#include "mic_work_event.h"
#include "sound_service.h"

LOG_MODULE_REGISTER(main, CONFIG_ESB_BT_LOG_LEVEL);

#define FW_VERSION		"1.2.9"

#define MOV_LED			DK_LED1
#define TIMESLOT_LED	DK_LED2

/* Key used to turn on circle drawing*/
#define KEY_ON_MASK		DK_BTN1_MSK
/* Key used to turn off circle drawing */
#define KEY_OFF_MASK    DK_BTN2_MSK

#define ESB_PKT_SIZE	72


/*
 * Get button configuration from the devicetree sw0 alias. This is mandatory.
 */
#define SW0_NODE	DT_ALIAS(sw0)
#if !DT_NODE_HAS_STATUS(SW0_NODE, okay)
#error "Unsupported board: sw0 devicetree alias is not defined"
#endif
static const struct gpio_dt_spec button = GPIO_DT_SPEC_GET_OR(SW0_NODE, gpios,{0});
static struct gpio_callback button_cb_data;


static const struct gpio_dt_spec leds[] = {
	// GPIO_DT_SPEC_GET(DT_ALIAS(led0), gpios),
	GPIO_DT_SPEC_GET(DT_ALIAS(led1), gpios),
	GPIO_DT_SPEC_GET(DT_ALIAS(led2), gpios),
};

static bool is_bt_connected = false;

extern struct k_msgq m_msgq_tx_payloads; 


void on_bt_callback(app_bt_event_t *event)
{
	switch(event->evt_type) {
		case APP_BT_EVT_CONNECTED:
			is_bt_connected = true;
			LOG_INF("BT CONNECTED");
			break;
		case APP_BT_EVT_DISCONNECTED:
			is_bt_connected = false;
			LOG_INF("BT DISCONNECTED");
			break;
	}
}


bool get_ble_status(void)
{
	return is_bt_connected;
}



static int leds_init(void)
{
	int err;

	if (!device_is_ready(leds[0].port)) {
		LOG_ERR("LEDs port not ready");
		return -ENODEV;
	}


	for (size_t i = 0; i < ARRAY_SIZE(leds); i++) {
		err = gpio_pin_configure_dt(&leds[i], GPIO_OUTPUT);
		if (err) {
			LOG_ERR("Cannot configure LED gpio");
			return err;
		}
		gpio_pin_set(leds[0].port, leds[i].pin, 0);
	}

	return 0;
}


void turn_on_off_led(bool onOff)
{
	size_t i = 0;
	if(onOff == true)
	{
		for ( i=0; i < ARRAY_SIZE(leds); i++) 
		{	
			gpio_pin_set(leds[0].port, leds[i].pin, 1);
		}
	}
	else
	{
		for (i = 0; i < ARRAY_SIZE(leds); i++) 
		{	
			gpio_pin_set(leds[0].port, leds[i].pin, 0);
		}
	}
}


static volatile bool button_flag = false;
static void button_pressed(const struct device *dev, struct gpio_callback *cb, uint32_t pins)
{
	button_flag = !button_flag;

	LOG_INF("Button pressed at %d	 button_flag=%d\n", k_cycle_get_32(),button_flag);

	// wake up device and trigger micphone to work
	if(button_flag)
	{
		struct mic_work_event *mic_event = new_mic_work_event();
		mic_event->type = MIC_STATUS_START;
		APP_EVENT_SUBMIT(mic_event);
	}
	else
	{
		struct mic_work_event *mic_event = new_mic_work_event();
		mic_event->type = MIC_STATUS_STOP;
		APP_EVENT_SUBMIT(mic_event);
	}
}


static int buttons_init( void )
{
	int err = 0;
	
	if (!device_is_ready(button.port)) {
		LOG_ERR("Could not bind to debug port");
		return -ENODEV;
	}

	err = gpio_pin_configure_dt(&button, GPIO_INPUT);
	if (err != 0) {
		LOG_ERR("Error %d: failed to configure %s pin %d\n",
		       err, button.port->name, button.pin);
		return err;
	}

	err = gpio_pin_interrupt_configure_dt(&button, GPIO_INT_EDGE_FALLING);
	if (err != 0) {
		LOG_ERR("Error %d: failed to configure interrupt on %s pin %d\n",
			err, button.port->name, button.pin);
		return err;
	}

	gpio_init_callback(&button_cb_data, button_pressed, BIT(button.pin));
	gpio_add_callback(button.port, &button_cb_data);
	LOG_INF("Set up button at %s pin %d\r\n", button.port->name, button.pin);

	return 0;
}


// extern struct k_mutex esb_mutex;
int main(void)
{
	int err;

	err = leds_init();
	if (err) {
		LOG_ERR("LEDs init failed (err %d)", err);
		return err;
	}
	
	err = buttons_init();
	if (err) {
		LOG_ERR("Cannot init buttons (err: %d)\n", err);
	}

	drv_audio_init();

	err = app_event_manager_init();
	if (err) {
		LOG_ERR("Unable to init Application Event Manager (%d)", err);
		return err;
	}

	LOG_INF("ESB BLE Multiprotocol Example, version is %s!\r\n",FW_VERSION);
	LOG_INF("Main thread priority is %d!\r\n",k_thread_priority_get(k_current_get()));

	err = app_bt_init(on_bt_callback);
	if (err) {
		LOG_ERR("app_bt init failed (err %d)", err);
		return err;
	}

	err = app_esb_init(APP_ESB_MODE_PTX);
	if (err) {
		LOG_ERR("app_esb init failed (err %d)", err);
		return err;
	}
	
	timeslot_init();

#if 0
	while (1) {		
		if (get_timeslot_status()) 
			pull_packet_from_tx_msgq();
		else
			k_sleep(K_MSEC(1));
	}
#endif
	return 0;
}
```

## src/sound_service.c
```c
#include <zephyr/kernel.h>
#include <zephyr/audio/dmic.h>
#include <zephyr/logging/log.h>
#include "sound_service.h"
#include "app_esb.h"
#include "dvi_adpcm.h"
#include "mic_work_event.h"

LOG_MODULE_REGISTER(sound_service, LOG_LEVEL_INF);

#define SOUND_STACK_SIZE        2048
#define SOUND_PRIORITY          5

/* Milliseconds to wait for a block to be read. */
#define READ_TIMEOUT            1000


static dvi_adpcm_state_t    m_adpcm_state;

/** this pointer variable used for transport the message queue to ESB thread.*/
// void *block_ptr = NULL;

static void mic_data_handle(void *, void *, void *)
{
    void *buffer;
	uint32_t size;
	static uint8_t esb_tx_buf[CONFIG_ESB_MAX_PAYLOAD_LENGTH] = {0};
	static uint8_t esb_total_size = 0;

    dvi_adpcm_init_state(&m_adpcm_state);

    LOG_INF("Sound service start, wait for PCM data......");

	/** suspend the thread until we received a start event*/
	k_thread_suspend(k_current_get());

    while(1)
    {
        int frame_size;
	    char frame_buf[MAX_BLOCK_SIZE/4 + 3] = {0};

        size = read_audio_data(&buffer, READ_TIMEOUT);
        if(size)
        {
			dvi_adpcm_encode(buffer, size, frame_buf, &frame_size,&m_adpcm_state, true);

			memcpy(&(esb_tx_buf[esb_total_size]), frame_buf, frame_size);
			esb_total_size += frame_size;

			if(esb_total_size >= CONFIG_ESB_MAX_PAYLOAD_LENGTH)
			{
				esb_package_enqueue(esb_tx_buf, CONFIG_ESB_MAX_PAYLOAD_LENGTH);
				memset(esb_tx_buf, 0, CONFIG_ESB_MAX_PAYLOAD_LENGTH);

				esb_total_size = 0;
			}
			
            free_audio_memory(buffer);
		}
		// LOG_INF("Sound service start, wait for PCM data......");
		// k_sleep(K_MSEC(1000));
    }
}



K_THREAD_DEFINE(sound_service, SOUND_STACK_SIZE,
                mic_data_handle, NULL, NULL, NULL,
                K_PRIO_PREEMPT(7), 0, 0);


extern void turn_on_off_led(bool onOff);
static bool mic_work_event_handler(const struct app_event_header *aeh)
{
	if (is_mic_work_event(aeh)) 
	{
		struct mic_work_event *event = cast_mic_work_event(aeh);
		if (event->type == MIC_STATUS_START) 
		{
            LOG_INF("Micphone start to work!");
			drv_mic_start();

			k_thread_resume(sound_service);
			
			turn_on_off_led(true);
			// test_pdm_transfer(BLOCK_COUNT);
		}
		else if(event->type == MIC_STATUS_STOP)
		{
            LOG_INF("Micphone stop to work!");
			drv_mic_stop();

			k_thread_suspend(sound_service);

            turn_on_off_led(false);
		}

		return true;
	}
	else
	{
		return false;
	}
}


APP_EVENT_LISTENER(mic_work, mic_work_event_handler);
APP_EVENT_SUBSCRIBE(mic_work, mic_work_event);
```

## src/sound_service.h
```c
#ifndef __SOUND_SERVICE_H__
#define __SOUND_SERVICE_H__

#include "drv_mic.h"


#define ESB_BLOCK_SIZE            (CONFIG_ESB_MAX_PAYLOAD_LENGTH - CONFIG_ESB_MAX_PAYLOAD_LENGTH % (MAX_BLOCK_SIZE/4 + 3))
// #define ADPCM_BLOCK_SIZE            MAX_BLOCK_SIZE
#define ADPCM_BLOCK_COUNT           20


void free_adpcm_memory(void *buffer);


#endif
```
