## src/modules/Kconfig.audio_service
```kconfig
#
# Copyright (c) 2018 Nordic Semiconductor
#
# SPDX-License-Identifier: LicenseRef-Nordic-5-Clause
#


menu "Sound service"

config DESKTOP_SMART_REMOTE
	bool "smart remote module"
	depends on (ESB && MPSL)
	depends on DESKTOP_PDM_MICROPHONE_ENABLE
	help
	  Enable nRF Desktop smart remote module for usb audio asssistance feature.
	  It needs a dongle to receive to audio stream and output to the host through 
	  USB audio class protocal.

config DESKTOP_MIC_ACTIVATION
    hex "Key ID of button used to control micphone"
    range 0x0000 0xffff
    help
      Button which should be used to enable and disable MIC.

config DESKTOP_MIC_WORK_TIMEOUT
	int "How long can the microphone work when it starts, unit seconds"
	range 0 120
	default 20
	help
	  when the audio feature been triggered, it starts a timer to count the micphone work time, 
	  when the timer expires, then we power off the micphone.

if DESKTOP_SMART_REMOTE

module = DESKTOP_SMART_REMOTE
module-str = smart remote

endif

endmenu
```

## src/smart_remote/Kconfig
```kconfig
#
# Copyright (c) 2019-2021 Nordic Semiconductor ASA
#
# SPDX-License-Identifier: LicenseRef-Nordic-5-Clause
#

menu "Micphone configuration"

config DESKTOP_PDM_MICROPHONE_ENABLE
	bool "Enable PDM microphone"
	depends on AUDIO_DMIC
	help
	  This option enables microphone sample in nRF Desktop application.
	  Could be used for audio application.

if DESKTOP_PDM_MICROPHONE_ENABLE

config DESKTOP_MICROPHONE_MAX_SAMPLE_RATE
	int "PCM sample rate of stream"
	default 16000
	help
		16 kHz output sample rate.

config DESKTOP_MICROPHONE_SAMPLE_BIT_WIDTH
	int "PCM sample width of stream"
	default 16
	help
	  16-bit samples.

config DESKTOP_MICROPHONE_CHNANEL_NUMBER
	int "number of channels."
	default 1
	range 1 2
	help
	  	actual number of channels in your microphone.

config DESKTOP_MICROPHONE_BLOCK_COUNT
	int "number of block memory, each one can save 1ms pcm data."
	default 60
	range 1 100
	help
	  	Driver will allocate blocks from this slab to receive audio data into them.
		Application, after getting a given block from the driver and processing its
		data, needs to free that block.



module = DESKTOP_PDM_MICROPHONE
module-str = desktop pdm microphone
source "subsys/logging/Kconfig.template.log_config"
endif

endmenu
```
